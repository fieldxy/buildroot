## support/testing/tests/core/br2-external/detect-overwrite/package/detect-overwrite/Config.in
```kconfig
config BR2_PACKAGE_DETECT_OVERWRITE
	bool "detect-overwrite"

config BR2_PACKAGE_HOST_DETECT_OVERWRITE
	bool "host-detect-overwrite"
```
